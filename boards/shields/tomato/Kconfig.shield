## boards/shields/tomato/Kconfig.shield
```kconfig
config SHIELD_TOMATO_LEFT
    def_bool $(shields_list_contains,tomato_left)

config SHIELD_TOMATO_RIGHT
    def_bool $(shields_list_contains,tomato_right)
```
